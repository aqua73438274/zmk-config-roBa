## boards/shields/roBa/Kconfig.defconfig
```kconfig
if SHIELD_ROBA_R

config ZMK_KEYBOARD_NAME
    default "roBa_R"

config ZMK_SPLIT_ROLE_CENTRAL
    default y

endif

if SHIELD_ROBA_L

config ZMK_KEYBOARD_NAME
    default "roBa_L"

endif


if SHIELD_ROBA_R || SHIELD_ROBA_L
config ZMK_SPLIT
    default y

config ZMK_KSCAN_CHARLIEPLEX_WAIT_BEFORE_INPUTS
    default 20
endif
```

## config/west.yml
```yaml
manifest:
  defaults:
    revision: main
  remotes:
    - name: cormoran
      url-base: https://github.com/cormoran
    # 既存のリモートはそのまま維持
    - name: kumamuk-git
      url-base: https://github.com/kumamuk-git
  projects:
    - name: zmk-feature-runtime-combo
      remote: cormoran
      revision: main
      import: true
    # ZMK: DYA Studio 用カスタム RPC サブシステム付き cormoran fork
    - name: zmk
      remote: cormoran
      revision: main+custom-studio-protocol
      import: app/west.yml

    - name: zmk-pmw3610-driver
      remote: cormoran
      revision: zmk-v0.3.0.0

    # DYA Studio モジュール（すべて cormoran リポジトリ）
    - name: zmk-module-ble-management
      remote: cormoran
      revision: zmk-v0.3.0.0
    - name: zmk-module-battery-history
      remote: cormoran
      revision: main
    - name: zmk-module-settings-rpc
      remote: cormoran
      revision: zmk-v0.3.0.0
    - name: zmk-module-runtime-input-processor
      remote: cormoran
      revision: zmk-v0.3.0.0

    # その他のモジュール（トラックボールドライバー、LED ウィジェット等）
    # ...
  self:
    path: config
```
